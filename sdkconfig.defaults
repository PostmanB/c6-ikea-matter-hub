## sdkconfig.defaults
```kconfig
CONFIG_IDF_TARGET="esp32c6"
CONFIG_ESPTOOLPY_FLASHSIZE_8MB=y
CONFIG_PARTITION_TABLE_CUSTOM=y
CONFIG_PARTITION_TABLE_CUSTOM_FILENAME="partitions.csv"
CONFIG_ESP_CONSOLE_USB_SERIAL_JTAG=y
CONFIG_ESP_CONSOLE_SECONDARY_NONE=y
CONFIG_ENABLE_CHIP_CONTROLLER_BUILD=y
CONFIG_ESP_MATTER_CONTROLLER_ENABLE=y
CONFIG_ESP_MATTER_COMMISSIONER_ENABLE=y
CONFIG_ESP_MATTER_ENABLE_MATTER_SERVER=n
CONFIG_CUSTOM_OPERATIONAL_CREDS_ISSUER=y
CONFIG_SPIFFS_ATTESTATION_TRUST_STORE=y
CONFIG_CHIP_FACTORY_NAMESPACE_PARTITION_LABEL="matter_nvs"
CONFIG_CHIP_CONFIG_NAMESPACE_PARTITION_LABEL="matter_nvs"
CONFIG_CHIP_COUNTERS_NAMESPACE_PARTITION_LABEL="matter_nvs"
CONFIG_CHIP_KVS_NAMESPACE_PARTITION_LABEL="matter_nvs"
CONFIG_CHIP_PROJECT_CONFIG="main/matter_project_config.h"
CONFIG_CHIP_TASK_STACK_SIZE=15360
CONFIG_ESP_MAIN_TASK_STACK_SIZE=10240
CONFIG_NUM_UDP_ENDPOINTS=16
CONFIG_BT_ENABLED=y
CONFIG_BT_NIMBLE_ENABLED=y
CONFIG_ENABLE_ESP32_BLE_CONTROLLER=y
CONFIG_BT_NIMBLE_EXT_ADV=n
CONFIG_BT_NIMBLE_HCI_EVT_BUF_SIZE=70
CONFIG_USE_BLE_ONLY_FOR_COMMISSIONING=n
CONFIG_ENABLE_CHIP_SHELL=y
CONFIG_ESP_MATTER_CONSOLE_TASK_STACK=6144
CONFIG_CHIP_SHELL_CMD_LINE_BUF_MAX_LENGTH=512
CONFIG_OPENTHREAD_ENABLED=y
CONFIG_ESP_MATTER_ENABLE_OPENTHREAD=y
CONFIG_OPENTHREAD_FTD=y
CONFIG_OPENTHREAD_SRP_CLIENT=y
CONFIG_OPENTHREAD_DNS_CLIENT=y
CONFIG_OPENTHREAD_CLI=n
CONFIG_OPENTHREAD_BORDER_ROUTER=n
CONFIG_OPENTHREAD_HEADER_CUSTOM=y
CONFIG_OPENTHREAD_CUSTOM_HEADER_PATH="main"
CONFIG_OPENTHREAD_CUSTOM_HEADER_FILE_NAME="esp_ot_custom_config.h"
CONFIG_USE_MINIMAL_MDNS=n
CONFIG_ENABLE_EXTENDED_DISCOVERY=y
CONFIG_ENABLE_WIFI_STATION=n
CONFIG_WIFI_NETWORK_COMMISSIONING_DRIVER=n
CONFIG_LWIP_IPV6_AUTOCONFIG=n
CONFIG_LWIP_IPV6_NUM_ADDRESSES=8
CONFIG_LWIP_MULTICAST_PING=y
CONFIG_MBEDTLS_HKDF_C=y
CONFIG_LOG_DEFAULT_LEVEL_INFO=y
CONFIG_ESP_COEX_SW_COEXIST_ENABLE=y
CONFIG_ESP_WIFI_STATIC_RX_BUFFER_NUM=4
CONFIG_ESP_WIFI_DYNAMIC_RX_BUFFER_NUM=8
CONFIG_ESP_WIFI_DYNAMIC_TX_BUFFER_NUM=8
CONFIG_HAP_PLATFORM_DEF_NVS_RUNTIME_PARTITION="home_nvs"
CONFIG_HAP_HTTP_MAX_OPEN_SOCKETS=4
```
